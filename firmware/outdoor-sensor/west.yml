## firmware/outdoor-sensor/west.yml
```yaml
manifest:
  projects:
    - name: zephyr
      url: https://github.com/zephyrproject-rtos/zephyr
      revision: v3.7-branch
      path: zephyr
      import: true
  self:
    path: .
```
